#include <Adafruit_NeoPixel.h>
#include <Wire.h>
#include <Adafruit_GFX.h>
#include <Adafruit_SSD1306.h>


#define SCREEN_WIDTH 128 // OLED display width, in pixels
#define SCREEN_HEIGHT 64 // OLED display height, in pixels
#define nextButton 2
#define selectButton 3
#define mxGreen 6
#define neo 2
#define delayVal 500

Adafruit_SSD1306 display(SCREEN_WIDTH, SCREEN_HEIGHT, &Wire, -1);
Adafruit_NeoPixel pixels(1, 1);

const int menuSize = 4;
String menuItems[menuSize];
bool next = HIGH;
bool selection = HIGH;
bool green = HIGH;
int currMenu = 0;
String temp;
char currentPrintOut[10];
long randNumber;
const int lowestPin = 7;
const int highestPin = 10;
int senses = 0;
int neoSwitch = 0;
String cute[11] = {"Be kind to yourself.", "You are so loved. ", "You are safe here.", "You can do it!", "You got this!", "You are wanted.", "GG!", "This too shall pass.", "Stay Focused.", "Keep it up!!!", "Roach is here for you!"};



//********************************************************************************************************
//Pics
// 'eye (2)', 24x24px
const unsigned char sense1 [] PROGMEM = {
  0x00, 0x00, 0x00, 0x00, 0x00, 0x00, 0x00, 0x00, 0x00, 0x00, 0x00, 0x00, 0x00, 0x3e, 0x00, 0x03,
  0x00, 0xc0, 0x0c, 0x00, 0x10, 0x10, 0x00, 0x08, 0x21, 0xc3, 0x84, 0x4d, 0x18, 0xb2, 0x70, 0x00,
  0x0c, 0xc2, 0x42, 0x03, 0x82, 0x46, 0x41, 0x00, 0x0a, 0x00, 0x41, 0x1e, 0x82, 0x20, 0x81, 0x04,
  0x10, 0x42, 0x08, 0x0c, 0x18, 0x30, 0x03, 0x00, 0xc0, 0x00, 0x7e, 0x00, 0x00, 0x00, 0x00, 0x00,
  0x00, 0x00, 0x00, 0x00, 0x00, 0x00, 0x00, 0x00
};
// 'favourite (2)', 24x24px
const unsigned char sense2 [] PROGMEM = {
  0x00, 0x01, 0xf8, 0x00, 0x00, 0x04, 0x00, 0x63, 0x04, 0x00, 0x9c, 0x88, 0x00, 0x08, 0x58, 0x01,
  0x00, 0x60, 0x00, 0x03, 0x40, 0x00, 0x85, 0x80, 0x02, 0x05, 0x00, 0x25, 0x25, 0x00, 0x21, 0x1d,
  0x60, 0x11, 0x05, 0x58, 0x0e, 0x05, 0x54, 0x00, 0x1d, 0x54, 0x00, 0x14, 0x04, 0x00, 0x10, 0x04,
  0x00, 0x10, 0x04, 0x00, 0x00, 0x08, 0x00, 0x08, 0x08, 0x00, 0x04, 0x10, 0x00, 0x02, 0x10, 0x00,
  0x04, 0x08, 0x00, 0x04, 0x08, 0x00, 0x06, 0x78
};
// 'ear (2)', 24x24px
const unsigned char sense3 [] PROGMEM = {
  0x00, 0x7e, 0x00, 0x01, 0x81, 0x80, 0x02, 0x00, 0x40, 0x04, 0x3c, 0x20, 0x00, 0x42, 0x00, 0x08,
  0x81, 0x10, 0x09, 0xf0, 0x90, 0x01, 0x08, 0x80, 0x00, 0x04, 0x80, 0x00, 0x04, 0x80, 0x01, 0x00,
  0x80, 0x01, 0x00, 0x80, 0x01, 0x80, 0x90, 0x00, 0x41, 0x10, 0x00, 0x42, 0x20, 0x01, 0x04, 0x40,
  0x01, 0x08, 0x80, 0x01, 0x09, 0x00, 0x01, 0x09, 0x00, 0x09, 0x11, 0x00, 0x08, 0x60, 0x00, 0x04,
  0x02, 0x00, 0x02, 0x04, 0x00, 0x01, 0xf0, 0x00
};
// 'breath (2)', 24x24px
const unsigned char sense4 [] PROGMEM = {
  0x00, 0x3c, 0x00, 0x00, 0x7e, 0x00, 0x00, 0x42, 0x00, 0x00, 0xc3, 0x00, 0x00, 0xc3, 0x00, 0x00,
  0xc3, 0x00, 0x00, 0x81, 0x00, 0x00, 0x81, 0x00, 0x00, 0x81, 0x00, 0x01, 0x81, 0x80, 0x01, 0x81,
  0x80, 0x03, 0x00, 0xc0, 0x02, 0x00, 0x40, 0x06, 0x00, 0x60, 0x06, 0x42, 0x60, 0x03, 0x42, 0xc0,
  0x03, 0xe7, 0xc0, 0x00, 0x3c, 0x00, 0x00, 0x00, 0x00, 0x01, 0xc3, 0x80, 0x03, 0xe7, 0xc0, 0x01,
  0x81, 0x80, 0x03, 0x00, 0xc0, 0x0e, 0x00, 0x70
};
// 'taste (2)', 24x24px
const unsigned char sense5 [] PROGMEM = {
  0x00, 0xe7, 0x00, 0x03, 0xbd, 0xc0, 0x06, 0x00, 0x60, 0x18, 0x00, 0x18, 0x31, 0xe7, 0x8c, 0x7f,
  0xff, 0xfe, 0xf8, 0x00, 0x1f, 0xc3, 0xe7, 0xc3, 0xf3, 0xff, 0xcf, 0x7e, 0x18, 0x7e, 0x36, 0x18,
  0x6c, 0x1e, 0x18, 0x78, 0x06, 0x00, 0x60, 0x06, 0x00, 0x60, 0x0f, 0xff, 0xf0, 0x0f, 0xff, 0xf0,
  0x08, 0x3c, 0x10, 0x08, 0x7e, 0x10, 0x0c, 0xdb, 0x30, 0x05, 0x99, 0xa0, 0x07, 0x18, 0xe0, 0x03,
  0x18, 0xc0, 0x01, 0xff, 0x80, 0x00, 0x7e, 0x00
};
// 'nature', 24x24px
const unsigned char sense6 [] PROGMEM = {
  0x00, 0x00, 0x00, 0x00, 0x03, 0x8a, 0x00, 0x00, 0x06, 0xc4, 0x00, 0x00, 0x0c, 0x64, 0x20, 0x00,
  0x08, 0x20, 0x52, 0x00, 0x18, 0x30, 0x8f, 0x00, 0x10, 0x10, 0x8d, 0x80, 0x10, 0x11, 0x08, 0x80,
  0x1f, 0xf3, 0x10, 0x40, 0x02, 0x82, 0x30, 0x60, 0x02, 0x84, 0x20, 0x20, 0x3f, 0xff, 0xff, 0xfc,
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  0x00, 0x60, 0x06, 0x00, 0x00, 0x1c, 0x38, 0x00, 0x00, 0x03, 0xc0, 0x00, 0x00, 0x00, 0x00, 0x00
};


// 'plant-pot', 64x64px
const unsigned char chibi1 [] PROGMEM = {
  0x00, 0x01, 0xfc, 0x00, 0x00, 0x3f, 0x80, 0x00, 0x00, 0x0f, 0xff, 0xc0, 0x03, 0xff, 0xf0, 0x00,
  0x00, 0x1e, 0x03, 0xe0, 0x07, 0x80, 0x78, 0x00, 0x00, 0x30, 0x00, 0x70, 0x0e, 0x00, 0x1c, 0x00,
  0x00, 0x60, 0x00, 0x18, 0x18, 0x00, 0x0e, 0x00, 0x00, 0x60, 0x00, 0x18, 0x18, 0x00, 0x3e, 0x00,
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  0x00, 0x00, 0x7f, 0xff, 0xff, 0xfe, 0x00, 0x00, 0x00, 0x00, 0x1f, 0xff, 0xff, 0xf8, 0x00, 0x00
};
// 'moon', 64x64px
const unsigned char chibi2 [] PROGMEM = {
  0x00, 0x00, 0x00, 0x0f, 0xfc, 0x00, 0x00, 0x00, 0x00, 0x00, 0x00, 0xff, 0xff, 0xe0, 0x00, 0x00,
  0x00, 0x00, 0x07, 0xf8, 0x03, 0xf8, 0x00, 0x00, 0x00, 0x01, 0xff, 0x00, 0xc0, 0x3e, 0x1c, 0x00,
  0x00, 0x07, 0xfe, 0x08, 0xc1, 0x07, 0xfe, 0x00, 0x00, 0x1f, 0x1f, 0x0c, 0x01, 0x81, 0xf7, 0x00,
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  0x00, 0x00, 0x01, 0xff, 0xff, 0xe0, 0x00, 0x00, 0x00, 0x00, 0x00, 0x0f, 0xfe, 0x00, 0x00, 0x00
};
// 'tea', 64x64px
const unsigned char chibi3 [] PROGMEM = {
  0x00, 0x00, 0x07, 0x80, 0x00, 0x00, 0x00, 0x00, 0x00, 0x00, 0x0f, 0xc0, 0x00, 0x00, 0x00, 0x00,
  0x00, 0x00, 0x1c, 0x60, 0x00, 0x00, 0x00, 0x00, 0x00, 0x00, 0x18, 0x70, 0x00, 0x00, 0x00, 0x00,
  0x00, 0x00, 0x10, 0x30, 0x00, 0x00, 0x00, 0x00, 0x00, 0x00, 0x30, 0x30, 0x3c, 0x00, 0x00, 0x00,
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  0x00, 0x03, 0xff, 0xff, 0xfe, 0x00, 0x00, 0x00, 0x00, 0x00, 0xff, 0xff, 0xfc, 0x00, 0x00, 0x00
};
// 'carrot', 64x64px
const unsigned char chibi4 [] PROGMEM = {
  0x00, 0x00, 0x00, 0x00, 0x0f, 0x80, 0x00, 0x00, 0x00, 0x00, 0x00, 0x00, 0x1f, 0xc0, 0x00, 0x00,
  0x00, 0x00, 0x00, 0x00, 0x38, 0xe0, 0x00, 0x00, 0x00, 0x00, 0x00, 0x38, 0x70, 0x60, 0x00, 0x00,
  0x00, 0x00, 0x00, 0xfc, 0x60, 0x20, 0x00, 0x00, 0x00, 0x00, 0x00, 0xc6, 0xc0, 0x60, 0x00, 0x00,
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  0x00, 0x00, 0x00, 0x0f, 0xf0, 0x00, 0x00, 0x00, 0x00, 0x00, 0x00, 0x03, 0xc0, 0x00, 0x00, 0x00
};



void setup() {

  //Pour Cerials***************************************************************
  Serial.begin(115200);

  //Begin Neopixl**************************************************************
  pixels.begin();
   pixels.clear();

  //Begin Display**************************************************************
  if (!display.begin(SSD1306_SWITCHCAPVCC, 0x3C)) { // Address 0x3D for 128x64
    Serial.println(F("SSD1306 allocation failed"));
    for (;;);
  }

  // setup Menu*****************************************************************
  menuItems[0] = "Breathing";
  menuItems[1] = "Grounding";
  menuItems[2] = "Vibin";
  menuItems[3] = "Its ok...";

  // setup the pullups for menu buttons*****************************************
  pinMode(nextButton, INPUT_PULLUP); // setup button 1
  pinMode(selectButton, INPUT_PULLUP); // setup button 2
  pinMode(mxGreen, INPUT_PULLUP); // setup button 3

  //random number***************************************************************
  randomSeed(analogRead(0));

  //Set pins as output for lights***********************************************
  for (int thisPin = lowestPin; thisPin <= highestPin; thisPin++)
  {
    pinMode(thisPin, OUTPUT);
  }

  //display startup message******************************************************
  display.clearDisplay();
  display.setTextSize(1);
  display.setTextColor(WHITE);
  display.setCursor(30, 25);
  display.println("Hey There,");
  display.println(" Its time to relax...");
  display.display();

}



void loop() {

  //Menu Logic ***************************************************************
  if (digitalRead(nextButton) != next) {
    next = !next;
    delay(50);
    if (!next) {
      //pressed
      if (currMenu > 0) {
        currMenu--;
      }
      else {
        currMenu =
          menuSize - 1;
      }
      MenuChanged();
      Serial.print (currMenu);
    }
  }

  //Select Logic ***************************************************************
  if (digitalRead(selectButton) != selection) {
    selection = !selection;
    delay(150);
    if (!selection) {
      delay(50);
      if (currMenu == 0) {
        pixels.clear();
        pixels.show();
        breath();
      }
      else if (currMenu == 3) {
        pixels.clear();
        pixels.show();
        ok();
      }
      else if (currMenu == 2) {
        switch (neoSwitch) {

          case 0: {
              pixels.clear();
              pixels.setPixelColor(0, pixels.Color(3, 255, 158));
              pixels.show();
              switch (neoSwitch++);
              pixels.setBrightness(35);
              display.clearDisplay();
              display.drawBitmap(30, 0, chibi1, 64, 64, WHITE);
              display.display();

            }
            break;

          case 1: {
              pixels.clear();
              pixels.setPixelColor(0, pixels.Color(84, 110, 255));
              pixels.show();
              pixels.setBrightness(30);
              switch (neoSwitch++);
              display.clearDisplay();
              display.drawBitmap(30, 0, chibi2, 64, 64, WHITE);
              display.display();



            }
            break;
          case 2: {
              pixels.clear();
              pixels.setPixelColor(0, pixels.Color(149, 0, 255));
              pixels.show();
              pixels.setBrightness(30);
              switch (neoSwitch++);
              display.clearDisplay();
              display.drawBitmap(30, 0, chibi3, 64, 64, WHITE);
              display.display();



            }
            break;
          case 3: {
              pixels.clear();
              pixels.setPixelColor(0, pixels.Color(255, 255, 0));
              pixels.show();
              pixels.setBrightness(35);
              switch (neoSwitch = 0);
              display.clearDisplay();
              display.drawBitmap(30, 0, chibi4, 64, 64, WHITE);
              display.display();



            }
            break;
        }
      }
      else if (currMenu == 1) {
        //**********************
        pixels.clear();
        pixels.show();
        display.clearDisplay();
        smolFont();
        switch (senses) {
          case 0: {
              display.drawBitmap(50, 7, sense1, 24, 24, WHITE);
              display.setCursor(0, 35);
              display.print( "What are five things you can See?");
              display.display();
              switch (senses++);

            }
            break;

          case 1: {
              display.drawBitmap(50, 7, sense2, 24, 24, WHITE);
              display.setCursor(0, 35);
              display.print( "What are four things I can Touch?");
              display.display();
              switch (senses++);

            }
            break;

          case 2: {
              display.drawBitmap(50, 7, sense3, 24, 24, WHITE);
              display.setCursor(0, 35);
              display.print( "What are three things you can Hear?");
              display.display();
              switch (senses++);

            }
            break;

          case 3: {
              display.drawBitmap(50, 7, sense4, 24, 24, WHITE);
              display.setCursor(0, 35);
              display.print( "What are two things you can Smell");
              display.display();
              switch (senses++);
            }
            break;

          case 4: {
              display.drawBitmap(50, 7, sense5, 24, 24, WHITE);
              display.setCursor(0, 35);
              display.print(  "What is one thing you can Taste? ");
              display.display();
              switch (senses++);
            }
            break;
          case 5: {
              display.drawBitmap(48, 7, sense6, 32, 32, WHITE);
              display.setCursor(0, 40);
              display.print(  "Now look at where you  are and breathe.");
              display.display();
              switch (senses = 0);
            }
            break;

        }
      }
    }
  }
}



//********************************************************************************************************
//Menu

void MenuChanged() {
  display.clearDisplay();
  bigFont();
  temp = String (menuItems[currMenu]);
  temp.toCharArray (currentPrintOut, 10);
  display.print(currentPrintOut);
  Serial.println(currentPrintOut); // write the menu item
  display.display();
  delay(25);
}

//********************************************************************************************************
//Text stuff

void bigFont() {
  display.setTextSize(2);
  display.setTextColor(WHITE);
  display.setCursor(5, 28);
}

void smolFont() {
  display.setTextSize(1);
  display.setTextColor(WHITE);
  display.setCursor(10, 25);
}


//********************************************************************************************************
//Its ok...

void ok() {
  smolFont();
   display.clearDisplay();
  randNumber = random(10);
  int message = randNumber;
  Serial.println (cute[message]);
  display.print (cute[message]);
  display.display();
}

//********************************************************************************************************
//running LEDs

void breath() {
  display.clearDisplay();
  smolFont();
  Serial.print ("Just take some time to breathe with the lights...");
  display.print ("Just take some time to breathe with the  lights...");
  display.display();
  for (int i = 0; i <= 3; i++) {
    for (int thisPin = lowestPin; thisPin <= highestPin; thisPin++)
    {
      digitalWrite(thisPin, HIGH);
      delay(1500);
    }
    delay(2500);
    for (int thisPin =
           highestPin; thisPin >= lowestPin; thisPin--)
    {
      digitalWrite(thisPin, LOW);
      delay(1500);
    }
    delay(2500);
  }
  display.clearDisplay();
  display.print ("Let's Reset");

}

//********************************************************************************************************
//Color led
void neoLight() {

}
